## Kconfig
```kconfig
config GPU_DEV
    bool "Enable VGLite GPU device"
    default y
    depends on DISPLAY

config GPU_DEV_NAME
    string "VGLite GPU device name"
    default "GPU"

config PM_DEVICE
    bool "Enable Device Power Management"
    depends on PM
    default y
    help
      Enable power management support for individual devices. 
      Each device can implement suspend/resume callbacks
      to reduce power consumption when idle.
      
config VG_LITE_K_MEM_POOL_SIZE
    hex "VG-Lite heap size"
    default 0x0
    help
      Size (in bytes) of the memory pool used by VG-Lite.

config VGLITE_STACK_SIZE
       int "VGLite thread stack size"
       default 8192
       help
         Stack size (bytes) for the VGLite worker/render thread.
         Increase if you see stack overflows during complex rendering tasks.

config VGLITE_TESS_WIDTH
	int "VG-Lite tessellation buffer width"
	default 128
	help
	  Width of the tessellation buffer for VG-Lite GPU.

config VGLITE_TESS_HEIGHT
	int "VG-Lite tessellation buffer height"
	default 1280
	help
	  Height of the tessellation buffer for VG-Lite GPU.

config VGLITE_CMD_BUF_SIZE
	int "VG-Lite command buffer size in bytes"
	default 262144
	help
	  Size of the command buffer for VG-Lite GPU operations.
	  Default is 256KB (262144 bytes).

config VGLITE_CONTIGUOUS_ALIGN
	int "VG-Lite contiguous memory alignment"
	default 64
	help
	  Alignment requirement for VG-Lite contiguous memory allocations.

config VGLITE_HEAP_USE_CUSTOM_SECTION
	bool "Use custom memory section (.vg_lite_heap) for VG-Lite heap"
	default y if SOC_SERIES_IMXRT5XX
	help
	  Place VG-Lite heap in .vg_lite_heap linker section.

config VG_LITE_INTERRUPT_PRIORITY
       int "VG Lite interrupt priority"
       default 3
       help
         Sets the interrupt priority for VG-Lite driver.
```
